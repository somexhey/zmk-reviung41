## boards/shields/reviung41_fix/Kconfig.defconfig
```kconfig
# Copyright (c) 2020 The ZMK Contributors
# SPDX-License-Identifier: MIT

if SHIELD_REVIUNG41_FIX

config ZMK_KEYBOARD_NAME
    default "Rev41"
config ZMK_SLEEP
    default y
config ZMK_IDLE_SLEEP_TIMEOUT
    default 900000
config ZMK_PM_SOFT_OFF
    default y

endif
```
